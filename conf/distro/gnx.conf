## conf/distro/gnx.conf
```bitbake
DISTRO_NAME = "Geanix"
DISTRO_VERSION = "0.1"

# Use the kernel/u-boot recipes from this layer
PREFERRED_PROVIDER_virtual/kernel = "linux-gnx"
PREFERRED_PROVIDER_virtual/bootloader = "u-boot-gnx"

# KERNEL_IMAGETYPE is deprecated by KERNEL_IMAGETYPES,
# but must be unset to avoid overriding the latter.
KERNEL_IMAGETYPE = ""

# Default to zImage for except for arm64
KERNEL_IMAGETYPES = "Image.gz"

# use systemd
DISTRO_FEATURES_append = " systemd"
DISTRO_FEATURES_remove = "sysvinit"
DISTRO_FEATURES_CONSIDERED += "sysvinit"
VIRTUAL-RUNTIME_init_manager = "systemd"
VIRTUAL-RUNTIME_initscripts = ""
VIRTUAL-RUNTIME_base-utils-syslog = ""
BAD_RECOMMENDATIONS_append = " udev-hwdb"

# default to read-only-rootfs
IMAGE_FEATURES = "read-only-rootfs"
```

## conf/layer.conf
```bitbake
# Heavily inspired by layer.conf from meta-oe

# We have a conf and classes directory, append to BBPATH
BBPATH .= ":${LAYERDIR}"

# We have recipes directories, add to BBFILES
BBFILES += "${LAYERDIR}/recipes-*/*/*.bb ${LAYERDIR}/recipes-*/*/*.bbappend"

# Define this layer
BBFILE_COLLECTIONS += "gnx-layer"
BBFILE_PATTERN_gnx-layer := "^${LAYERDIR}/"

# Define the priority for recipes (.bb files) from this layer,
# choosing carefully how this layer interacts with all of the
# other layers. Higher values have higher priority.
BBFILE_PRIORITY_gnx-layer = "9"

# Tell bitbake that this layer depends on other layers
LAYERDEPENDS_gnx-layer = "core openembedded-layer"

# Tell bitbake which Yocto release this layer is compatible with
LAYERSERIES_COMPAT_gnx-layer = "thud"
```

## conf/machine/rpi3.conf
```bitbake
require conf/machine/include/arm/arch-armv8.inc

# Raspberry Pi has no hardware clock
MACHINE_FEATURES_BACKFILL_CONSIDERED = "rtc"

# set default console
SERIAL_CONSOLES = "115200;ttyS1"

# Configure u-boot build
UBOOT_MACHINE = "rpi_3_defconfig"
UBOOT_BINARY = "u-boot.bin"
UBOOT_ENV_SIZE = "0x4000"
UBOOT_ENV_DEVICE = "/rpi/uboot.env"

KERNEL_DEVICETREE = " \
    broadcom/bcm2837-rpi-3-b-plus.dtb \
    broadcom/bcm2837-rpi-3-b.dtb \
"

# Configure installation of bootfiles and u-boot on first partition
IMAGE_BOOT_FILES = "${UBOOT_BINARY} uboot.env rpi-bootfiles/* rpi-config/*"
WKS_FILE_DEPENDS = "virtual/bootloader rpi-bootfiles rpi-config"

MACHINE_EXTRA_RDEPENDS = " \
    u-boot-gnx-fw-utils \
    kernel-module-lan78xx \
"
```

## wic/rpi3.wks
```
part /rpi --source bootimg-partition --fstype vfat --ondisk mmcblk0 --active --fixed-size 16M
part / --source rootfs --fstype ext4 --ondisk mmcblk0 --fixed-size 1024M
```
